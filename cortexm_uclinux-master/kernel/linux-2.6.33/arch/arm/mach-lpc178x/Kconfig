## cortexm_uclinux-master/kernel/linux-2.6.33/arch/arm/mach-lpc178x/Kconfig
```kconfig
if ARCH_LPC178X

config MACH_LPC178X
	bool
	default y
	select ARM_NVIC if CPU_V7M
	help
	  Include support for the NXP LPC178x/7x SoCs

menu "LPC178x/7x I/O interfaces"
	depends on ARCH_LPC178X

config LPC178X_TOUCH1
	depends on ARCH_LPC178X && TOUCHSCREEN_TSC2046
	bool "Enable LPC178x/7x SPI0 port"
	default n

config LPC178X_TOUCH2
	depends on ARCH_LPC178X && TOUCHSCREEN_TSC2046
	bool "Enable LPC178x/7x SPI0 port"
	default n

config LPC178X_TOUCH3
	depends on ARCH_LPC178X && TOUCHSCREEN_TSC2046
	bool "Enable LPC178x/7x SPI0 port"
	default n

config LPC178X_I2C0
	depends on ARCH_LPC178X && I2C_LPC2K
	bool "Enable LPC178x/7x I2C0 port"
	default n

config LPC178X_I2C1
	depends on ARCH_LPC178X && I2C_LPC2K
	bool "Enable LPC178x/7x I2C1 port"
	default n

config LPC178X_I2C2
	depends on ARCH_LPC178X && I2C_LPC2K
	bool "Enable LPC178x/7x I2C2 port"
	default n

config I2C_AT24C08
	depends on ARCH_LPC178X && I2C_LPC2K
	bool "Enable LPC178x/7x AT24C08"
	default n

config I2C_RFID
	depends on ARCH_LPC178X && I2C_LPC2K
	bool "Enable LPC178x/7x RFID"
	default n

config LPC178X_SPI0
	depends on ARCH_LPC178X && SPI_LPC1788
	bool "Enable LPC178x/7x SPI0 port"
	default n

config LPC178X_SPI1
	depends on ARCH_LPC178X && SPI_LPC1788
	bool "Enable LPC178x/7x SPI1 port"
	default n

config LPC178X_SPI2
	depends on ARCH_LPC178X && SPI_LPC1788
	bool "Enable LPC178x/7x SPI2 port"
	default n

config LPC178X_UART0
	depends on ARCH_LPC178X && SERIAL_8250
	bool "Enable LPC178x/7x UART0 port"
	default y

config LPC178X_UART1
	depends on ARCH_LPC178X && SERIAL_8250
	bool "Enable LPC178x/7x UART1 port"
	default n

config LPC178X_UART2
	depends on ARCH_LPC178X && SERIAL_8250
	bool "Enable LPC178x/7x UART2 port"
	default n

config LPC178X_UART3
	depends on ARCH_LPC178X && SERIAL_8250
	bool "Enable LPC178x/7x UART3 port"
	default n

config LPC178X_UART4
	depends on ARCH_LPC178X && SERIAL_8250
	bool "Enable LPC178x/7x UART4 port"
	default n

config LPC178X_MAC
	depends on ARCH_LPC178X && LPC178X_ETHER
	bool "Enable LPC178x/7x Ethernet port"
	default y

config LPC178X_KEY
	depends on ARCH_LPC178X
	bool "Enable LPC178x/7x key button"
	default n

config LPC178X_SD_DMA
	depends on ARCH_LPC178X && MMC_ARMMMCI
	bool "Use DMA for the SD Card Interface"
	default y

config LPC178X_WATCHDOG
	depends on ARCH_LPC178X && LPC2K_WATCHDOG
	bool "Enable LPC178x Watchdog"
	default n

endmenu

endif
```
